## hw/direct-express/Kconfig
```kconfig
config DIRECT_EXPRESS
    bool
    default y
    depends on PCI && VIRTIO && DIRECT_EXPRESS_PCI

config DIRECT_EXPRESS_PCI
    bool
    default y
    depends on PCI && VIRTIO
```

## hw/vsoc/Kconfig
```kconfig
config TELEPORT_EXPRESS
    bool
    default y
    depends on PCI && VIRTIO && TELEPORT_EXPRESS_PCI

config TELEPORT_EXPRESS_PCI
    bool
    default y
    depends on PCI && VIRTIO

source camera/Kconfig
source codec/Kconfig
source display/Kconfig
source gpu/Kconfig
source input/Kconfig
source mem/Kconfig
source network/Kconfig
source sensor/Kconfig
```
